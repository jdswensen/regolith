## build/conf/bblayers.conf
```bitbake
# POKY_BBLAYERS_CONF_VERSION is increased each time build/conf/bblayers.conf
# changes incompatibly
POKY_BBLAYERS_CONF_VERSION = "2"

BBPATH = "${TOPDIR}"
PROJECT_DIR = "${TOPDIR}/.."
BBFILES ?= ""

BBLAYERS ?= " \
  ${PROJECT_DIR}/sources/meta-openembedded/meta-networking \
  ${PROJECT_DIR}/sources/meta-openembedded/meta-oe \
  ${PROJECT_DIR}/sources/meta-openembedded/meta-python \
  ${PROJECT_DIR}/sources/poky/meta \
  ${PROJECT_DIR}/sources/poky/meta-poky \
  ${PROJECT_DIR}/sources/poky/meta-yocto-bsp \
"
```
